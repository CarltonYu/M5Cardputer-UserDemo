## ESP32S3N16R8/main/Kconfig.projbuild
```kconfig
menu "ESP32S3N16R8 User Demo Port"

    menu "HAL / I2C"

        config HAL_I2C_SDA_GPIO
            int "Internal I2C SDA GPIO"
            range -1 48
            default 17

        config HAL_I2C_SCL_GPIO
            int "Internal I2C SCL GPIO"
            range -1 48
            default 18

        config HAL_I2C_FREQ_HZ
            int "Internal I2C clock frequency (Hz)"
            range 50000 1000000
            default 400000

        config HAL_I2C_EXT_SDA_GPIO
            int "External/Grove I2C SDA GPIO (-1 to disable)"
            range -1 48
            default 15

        config HAL_I2C_EXT_SCL_GPIO
            int "External/Grove I2C SCL GPIO (-1 to disable)"
            range -1 48
            default 16

        config HAL_KEYBOARD_INT_GPIO
            int "TCA8418 keyboard INT GPIO"
            range -1 48
            default 21

        config HAL_MPU6050_ADDR
            hex "MPU6050 I2C address"
            range 0x10 0x78
            default 0x68

    endmenu

    menu "ST7789 LCD"

        config LCD_PIN_MOSI
            int "LCD MOSI/SDA GPIO"
            range -1 48
            default 11

        config LCD_PIN_SCLK
            int "LCD SCLK/SCL GPIO"
            range -1 48
            default 12

        config LCD_PIN_CS
            int "LCD CS GPIO"
            range -1 48
            default 10

        config LCD_PIN_DC
            int "LCD DC GPIO"
            range -1 48
            default 9

        config LCD_PIN_RST
            int "LCD RST/RES GPIO"
            range -1 48
            default 8

        config LCD_PIN_BL
            int "LCD BL/BLK GPIO"
            range -1 48
            default 7

        config LCD_PIN_MISO
            int "Shared SPI MISO GPIO (used by SD card)"
            range -1 48
            default 13

        config LCD_SPI_CLOCK_HZ
            int "LCD SPI pixel clock Hz"
            range 1000000 80000000
            default 40000000

        config LCD_BACKLIGHT_ACTIVE_HIGH
            bool "LCD backlight is active high"
            default y

        config LCD_BGR_COLOR
            bool "Use BGR color element order"
            default n

        config LCD_INVERT_COLOR
            bool "Invert ST7789 colors"
            default n

        config LCD_SWAP_XY
            bool "Swap LCD X/Y axes for landscape"
            default y

        config LCD_MIRROR_X
            bool "Mirror LCD X axis"
            default y

        config LCD_MIRROR_Y
            bool "Mirror LCD Y axis"
            default n

        config LCD_GAP_X
            int "LCD X offset/gap"
            range 0 80
            default 0

        config LCD_GAP_Y
            int "LCD Y offset/gap"
            range 0 80
            default 0

    endmenu

    menu "EC11 Rotary Encoder And Buttons"

        config ENCODER_PIN_A
            int "EC11 A GPIO"
            range 0 48
            default 4

        config ENCODER_PIN_B
            int "EC11 B GPIO"
            range 0 48
            default 5

        config ENCODER_PIN_PUSH
            int "EC11 push GPIO"
            range -1 48
            default 6

        config BUTTON_OK_PIN
            int "OK button GPIO"
            range -1 48
            default 3

        config INPUT_ACTIVE_LOW
            bool "Buttons/encoder use active-low inputs with internal pull-ups"
            default y

        config ENCODER_REVERSE
            bool "Reverse EC11 rotation direction"
            default n

        config BUTTON_DEBOUNCE_MS
            int "Button debounce time ms"
            range 5 100
            default 25

    endmenu

    menu "SD Card (SDSPI)"

        config SD_PIN_CS
            int "SD card CS GPIO"
            range -1 48
            default 14

        config SD_PIN_MISO
            int "SD card MISO GPIO"
            range -1 48
            default 13

        config SD_PIN_CD
            int "SD card CD (card detect) GPIO (-1 to disable)"
            range -1 48
            default 15

        config SD_SPI_CLOCK_HZ
            int "SD card SPI clock Hz"
            range 100000 20000000
            default 100000

    endmenu

    menu "Audio (ES8311 + I2S)"

        config AUDIO_I2S_SDA_GPIO
            int "Audio I2C SDA GPIO"
            range -1 48
            default 17

        config AUDIO_I2S_SCL_GPIO
            int "Audio I2C SCL GPIO"
            range -1 48
            default 18

        config AUDIO_I2S_MCLK_GPIO
            int "Audio I2S MCLK GPIO"
            range -1 48
            default 38

        config AUDIO_I2S_BCLK_GPIO
            int "Audio I2S BCLK/SCLK GPIO"
            range -1 48
            default 35

        config AUDIO_I2S_WS_GPIO
            int "Audio I2S LRCK/WS GPIO"
            range -1 48
            default 36

        config AUDIO_I2S_DIN_GPIO
            int "Audio I2S DIN (ESP32 mic in) GPIO"
            range -1 48
            default 37

        config AUDIO_I2S_DOUT_GPIO
            int "Audio I2S DOUT (ESP32 speaker out) GPIO"
            range -1 48
            default 47

        config AUDIO_SAMPLE_RATE
            int "Audio sample rate (Hz)"
            range 8000 48000
            default 16000

        config AUDIO_I2S_PORT
            int "Audio I2S port number"
            range 0 1
            default 0

    endmenu

    menu "ESP-NOW Chat"

        config ESPNOW_CHANNEL
            int "ESP-NOW Wi-Fi channel"
            range 1 14
            default 1

    endmenu

endmenu
```
